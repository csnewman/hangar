## internal/kernel/tree/fs/hangar/Kconfig
```kconfig
# SPDX-License-Identifier: GPL-2.0
config HANGAR_FS
	bool "Hangar: hangarfs, the environment's root"
	depends on FILE_LOCKING
	select FS_STACK
	help
	  A thin stacking filesystem over a directory, passing every operation
	  through to it, which Hangar's guest agent mounts as an environment's
	  root over its overlayfs. Names the agent routes -- the files an
	  environment shares with others -- are served from another directory,
	  an NFS mount of them, instead, where locks on them hold between
	  environments.
```
